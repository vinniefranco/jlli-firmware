## boards/shields/jlli/Kconfig.defconfig
```kconfig
if SHIELD_JLLI_RIGHT

config ZMK_KEYBOARD_NAME
  default "jlli"

config ZMK_SPLIT_ROLE_CENTRAL
  default y

endif

if SHIELD_JLLI_LEFT || SHIELD_JLLI_RIGHT

config ZMK_SPLIT
  default y

endif
```

## boards/shields/jlli/Kconfig.shield
```kconfig
config SHIELD_JLLI
  def_bool $(shields_list_contains,jlli)

config SHIELD_JLLI_LEFT
  def_bool $(shields_list_contains,jlli_left)

config SHIELD_JLLI_RIGHT
  def_bool $(shields_list_contains,jlli_right)
```
